## hw/rdma/Kconfig
```kconfig
config VMW_PVRDMA
    default y if PCI_DEVICES
    depends on PVRDMA && PCI && MSI_NONBROKEN

config VHOST_USER_RDMA
    bool
    default y if VIRTIO_PCI
    depends on VIRTIO && VHOST_USER && LINUX
```
